## src/sensors/hardware/esp32_imu/main/Kconfig.projbuild
```kconfig
menu "LSM6DSO32 I2C Configuration"
    depends on I2C_MASTER_ISR_CONFIG_IN_IRAM

    config I2C_MASTER_SCL
        int "I2C Master SCL GPIO number"
        range 0 39
        default 5

    config I2C_MASTER_SDA
        int "I2C Master SDA GPIO number"
        range 0 39
        default 4

    config I2C_MASTER_FREQUENCY
        int "I2C Master clock frequency (Hz)"
        default 400000
endmenu
```
